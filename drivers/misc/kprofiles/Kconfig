## drivers/misc/kprofiles/Kconfig
```kconfig
# SPDX-License-Identifier: GPL-2.0
config KPROFILES
	bool "Manual KProfiles"
	depends on SYSFS
	help
	  Manual kernel profile selection through /sys/kernel/kprofiles/kp_mode.
	  Drivers consume the selected mode to tune input boosts. No automatic
	  screen-off switching, temporary overrides or notifier API is included.

if KPROFILES
config KP_DEFAULT_MODE
	int "Default KProfiles mode"
	range 0 3
	default 0
	help
	  0 preserves current tuning, 1 is Battery, 2 Balanced, 3 Performance.
endif
```
